VERSION ""

NS_ :

BS_:

BU_: MASTER SENSOR MOTOR GPS ANDROID

BO_ 200 CAN_TEST: 1 MASTER
 SG_ CAN_TEST_master : 0|8@1+ (1,0) [0|0] "" SENSOR,MOTOR,GPS,ANDROID

BO_ 300 SENSOR_MESSAGE: 1 SENSOR
 SG_ SENSOR_MESSAGE_sig : 0|8@1+ (1,0) [0|0] "" MASTER

BO_ 301 MOTOR_MESSAGE: 1 MOTOR
 SG_ MOTOR_MESSAGE_sig : 0|8@1+ (1,0) [0|0] "" MASTER

BO_ 302 ANDROID_MESSAGE: 1 ANDROID
 SG_ ANDROID_MESSAGE_sig : 0|8@1+ (1,0) [0|0] "" MASTER

BO_ 303 GPS_MESSAGE: 1 GPS
 SG_ GPS_MESSAGE_sig : 0|8@1+ (1,0) [0|0] "" MASTER

BO_ 201 MOTOR_MOVEMENT: 1 MASTER
 SG_ MOTOR_MOVEMENT_sig : 0|8@1+ (1,0) [0|0] "" MOTOR

BO_ 100 KILL_SWITCH: 1 MASTER
 SG_ KILL_SWITCH_Sig : 0|1@1+ (1,0) [0|0] "" SENSOR,MOTOR,GPS,ANDROID

CM_ BU_ MASTER "The master controller of the car";
CM_ BU_ SENSOR "The sensor controller on the car";
CM_ BU_ MOTOR "The motor controller of the car";
CM_ BU_ GPS "The GPS controller of the car";
CM_ BU_ ANDROID "The Android controller of the car";

BA_DEF_ "BusType" STRING ;

BA_DEF_DEF_ "BusType" "CAN";
