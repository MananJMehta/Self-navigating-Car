VERSION ""

NS_ :

BS_:

BU_: MASTER MOTOR SENSOR GPS ANDROID

BO_ 500 HEARTBEAT_SENSOR: 1 SENSOR
 SG_ HEARTBEAT_SENSOR_pulse : 0|1@1+ (1,0) [0|0] "" MASTER

BO_ 501 HEARTBEAT_GPS: 1 GPS
 SG_ HEARTBEAT_GPS_pulse : 0|1@1+ (1,0) [0|0] "" MASTER

BO_ 502 HEARTBEAT_MOTOR: 1 MOTOR
 SG_ HEARTBEAT_MOTOR_pulse : 0|1@1+ (1,0) [0|0] "" MASTER

BO_ 503 HEARTBEAT_ANDROID: 1 ANDROID
 SG_ HEARTBEAT_ANDROID_pulse : 0|1@1+ (1,0) [0|0] "" MASTER
