VERSION ""

NS_ :

BS_:

BU_: MASTER SENSOR MOTOR GPS ANDROID

BO_ 100 CAN_TEST: 1 MASTER
 SG_ CAN_TEST_master : 0|8@1+ (1,0) [0|0] "" SENSOR,MOTOR,GPS,ANDROID

CM_ BU_ MASTER "The master controller of the car";
CM_ BU_ SENSOR "The sensor controller on the car";
CM_ BU_ MOTOR "The motor controller of the car";
CM_ BU_ GPS "The GPS controller of the car";
CM_ BU_ ANDROID "The Android controller of the car";

BA_DEF_ "BusType" STRING ;

BA_DEF_DEF_ "BusType" "CAN";
